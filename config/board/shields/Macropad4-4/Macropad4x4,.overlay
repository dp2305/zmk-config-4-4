#include <dt-bindings/zmk/matrix_transform.h>

/ {
    choose {
        zmk,kscan = &default_kscan;
        zmk,matrix_transform =&default_transform;
    };

    default_kscan: kscan
     {
        compatible = "zmk,kscan-gpio-matrix";
        label = "default_kscan";
        diode-direction = "col2row";

        row-gpio = <&pro_micro 9 (GPIO_ACTIVE_HIGH | GPIO_PULL_DOWN)>,
                   <&pro_micro 10 (GPIO_ACTIVE_HIGH | GPIO_PULL_DOWN)>,
                   <&pro_micro 11 (GPIO_ACTIVE_HIGH | GPIO_PULL_DOWN)>,
                   <&pro_micro 12 (GPIO_ACTIVE_HIGH | GPIO_PULL_DOWN)>,
        
        Col-gpio = <&pro_micro 5 GPIO_ACTIVE_HIGH>,
                   <&pro_micro 6 GPIO_ACTIVE_HIGH>,
                   <&pro_micro 7 GPIO_ACTIVE_HIGH>,
                   <&pro_micro 8 GPIO_ACTIVE_HIGH>;
    }

    default_transform: matrix_transform 
    {
        compatible = "zmk,matrix_transform";
        row = <4>;
        column = <4>;

        map = <
            RC(0,0) RC(0,1) RC(0,2) RC(0,3)
            RC(1,0) RC(1,1) RC(1,2) RC(1,3)
            RC(2,0) RC(2,1) RC(2,2) RC(2,3)
            RC(3,0) RC(3,1) RC(3,2) RC(3,3)
        >
    }
}